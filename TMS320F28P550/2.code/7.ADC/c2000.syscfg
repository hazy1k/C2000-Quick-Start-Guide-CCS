/**
 * @cliArgs --device "F28P55x" --part "F28P55x_128PDT" --package "128PDT" --context "system" --product "C2000WARE@5.05.00.00"
 * @versions {"tool":"1.24.0+4110"}
 */

/**
 * Import the modules used in this configuration.
 */
const adc     = scripting.addModule("/driverlib/adc.js", {}, false);
const adc1    = adc.addInstance();
const analog  = scripting.addModule("/driverlib/analog.js", {}, false);
const analog1 = analog.addInstance();

/**
 * Write custom configuration values to the imported modules.
 */
adc1.$name             = "myADC0";
adc1.adcClockPrescaler = "ADC_CLK_DIV_2_0";
adc1.enabledSOCs       = ["ADC_SOC_NUMBER0"];
adc1.soc0Channel       = "ADC_CH_ADCIN6";
adc1.soc0SampleWindow  = 20;

analog1.$name            = "myANALOGPinMux0";
adc1.analog              = analog1;
analog1.useCase          = "CUSTOM";
analog1.useInterfacePins = ["A6, D14, E14, GPIO228"];

/**
 * Pinmux solution for unlocked pins/peripherals. This ensures that minor changes to the automatic solver in a future
 * version of the tool will not impact the pinmux you originally saw.  These lines can be completely deleted in order to
 * re-solve from scratch.
 */
analog1.analog.$suggestSolution                             = "ANALOG";
analog1.analog["a6, d14, e14, gpio228Pin"].$suggestSolution = "A6, D14, E14, GPIO228";
